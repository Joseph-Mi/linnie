## conf/distro/recover.conf
```bitbake
DISTRO = 
DISTRO_NAME = 
DISTRO_VERSION =
MAINTAINER =

# C library we want

# minimal featureset, want systemd, GUI, networking, ssh, package management, etc.
DISTRO_FEATURES = "x11 wayland opengl ptest package-management ssh systemd wifi bluetooth"

# quality insurance check
ERROR_QA.append = ""
WARN_QA.append = ""
```

## conf/layer.conf
```bitbake
BBPATH .= ":${LAYERDIR}"

BBFILES += "${LAYERDIR}/recipes-*/*/*.bb \
            ${LAYERDIR}/recipes-*/*/*.bbappend"

BBFILE_COLLECTIONS += "meta-linnie"
BBFILE_PATTERN_meta-linnie = "^${LAYERDIR}/"
BBFILE_PRIORITY_meta-linnie = "8" # priority 8

LAYERDEPENDS_meta-linnie = "core"
LAYERSERIES_COMPAT_meta-linnie = "scarthgap"
```

## conf/machine/cm5-mi450-linnie.conf
```bitbake
# 2025 CM5 Systems
# @TYPE: Machine
# @NAME: cm5-mi450-linnie
# @DESCRIPTION: CM5 MI450 Linnie Machine Configuration

require conf/machine
```

## sources/meta-linnie-app/conf/layer.conf
```bitbake
# We have a conf and classes directory, add to BBPATH
BBPATH .= ":${LAYERDIR}"

# We have recipes-* directories, add to BBFILES
BBFILES += "${LAYERDIR}/recipes-*/*/*.bb \
            ${LAYERDIR}/recipes-*/*/*.bbappend"

BBFILE_COLLECTIONS += "meta-linnie-app"
BBFILE_PATTERN_meta-linnie-app = "^${LAYERDIR}/"
BBFILE_PRIORITY_meta-linnie-app = "12"

LAYERDEPENDS_meta-linnie-app = "core raspberrypi meta-linnie meta-linnie-drivers"
LAYERSERIES_COMPAT_meta-linnie-app = "scarthgap"
```

## sources/meta-linnie-drivers/conf/layer.conf
```bitbake
# We have a conf and classes directory, add to BBPATH
BBPATH .= ":${LAYERDIR}"

BBFILES += "${LAYERDIR}/recipes-*/*/*.bb \
            ${LAYERDIR}/recipes-*/*/*.bbappend"

BBFILE_COLLECTIONS += "meta-linnie-drivers"
BBFILE_PATTERN_meta-linnie-drivers = "^${LAYERDIR}/"
BBFILE_PRIORITY_meta-linnie-drivers = "11"

LAYERDEPENDS_meta-linnie-drivers = "core raspberrypi meta-linnie"
LAYERSERIES_COMPAT_meta-linnie-drivers = "scarthgap"
```

## sources/meta-linnie/conf/distro/linnie.conf
```bitbake
# Linnie Distribution Configuration
DISTRO = "linnie"
DISTRO_NAME = "Linnie"
DISTRO_VERSION = "1.0.0"
MAINTAINER = "Linnie Maintainers"

# Use systemd as init system
INIT_MANAGER = "systemd"
DISTRO_FEATURES:append = " systemd"
DISTRO_FEATURES_BACKFILL_CONSIDERED:append = " sysvinit"
VIRTUAL-RUNTIME_init_manager = "systemd"
VIRTUAL-RUNTIME_initscripts = "systemd-compat-units"

# Distribution features
DISTRO_FEATURES = "x11 wayland opengl ptest package-management ssh systemd wifi bluetooth"

# Enable UART for debugging (optional but useful)
ENABLE_UART = "1"

# Quality assurance settings
ERROR_QA:append = ""
WARN_QA:append = ""

# Enable Device Tree Overlays
# - thermal-overlay: 6x TMP100 temperature sensors on I2C1
# - uart2: UART debugging
# - camera-overlay: CSI camera (disabled for now, using USB camera)
RPI_EXTRA_CONFIG:append = "\
    dtoverlay=thermal-overlay \
    dtoverlay=uart2 "
    # dtoverlay=camera-overlay \
```

## sources/meta-linnie/conf/layer.conf
```bitbake
# Linnie custom layer configuration
BBPATH .= ":${LAYERDIR}"

BBFILES += "${LAYERDIR}/recipes-*/*/*.bb \
            ${LAYERDIR}/recipes-*/*/*.bbappend"

BBFILE_COLLECTIONS += "meta-linnie"
BBFILE_PATTERN_meta-linnie = "^${LAYERDIR}/"
BBFILE_PRIORITY_meta-linnie = "8"

LAYERDEPENDS_meta-linnie = "core raspberrypi"
LAYERSERIES_COMPAT_meta-linnie = "scarthgap"
```

## sources/meta-linnie/conf/machine/cm5-mi450-linnie.conf
```bitbake
# 2025 CM5 Systems
# @TYPE: Machine
# @NAME: cm5-mi450-linnie
# @DESCRIPTION: CM5 MI450 Linnie Machine Configuration
#
# This machine inherits from raspberrypi5.conf (found in meta-raspberrypi layer).
# BitBake's require searches all layer directories - no relative paths needed.
#
# Carrier board peripherals:
#   - 6x TMP100 temperature sensors on I2C1 (0x48, 0x49, 0x4A, 0x4C, 0x4D, 0x4E)
#   - USB 3.0 ports for camera ajd mouse
#   - HDMI output for display
#   - CSI connector (for future camera expansion)

# Base machine - Raspberry Pi CM5 (from meta-raspberrypi)
require conf/machine/raspberrypi5.conf

# CRITICAL: Tell kernel build system to use raspberrypi5's kernel configuration
KMACHINE = "raspberrypi5"
KMACHINE:cm5-mi450-linnie = "raspberrypi5"

# Ensure proper machine override inheritance
MACHINEOVERRIDES =. "raspberrypi5:"

# USB camera support (Logitech C920x and other UVC cameras)
MACHINE_EXTRA_RRECOMMENDS += " \
    kernel-module-uvcvideo \
    kernel-module-videobuf2-v4l2 \
    kernel-module-videobuf2-vmalloc \
"

# I2C support for temperature sensors
MACHINE_FEATURES:append = " i2c"
```
